## crypto/ml_dsa/Kconfig
```kconfig
# SPDX-License-Identifier: GPL-2.0
menuconfig CRYPTO_ML_DSA
	tristate "ML-DSA/Dilithium algorithm"
	select CRYPTO_LIB_SHA3

if CRYPTO_ML_DSA

config CRYPTO_DILITHIUM_44
	bool "Enable Dilithium-44 support"

config CRYPTO_DILITHIUM_65
	bool "Enable Dilithium-65 support"

config CRYPTO_DILITHIUM_87
	bool "Enable Dilithium-87 support"

config CRYPTO_ML_DSA_TEST
	tristate "ML-DSA/Dilithium KUnit tests"
	depends on KUNIT
	default KUNIT_ALL_TESTS
	help
	  This options enables the KUnit tests for ML-DSA.

	  KUnit tests run during boot and output the results to the debug
	  log in TAP format (https://testanything.org/). Only useful for
	  kernel devs running KUnit test harness and are not for inclusion
	  into a production build.

	  For more information on KUnit and unit tests in general, refer
	  to the KUnit documentation in Documentation/dev-tools/kunit/.

endif
```

## security/integrity/digest_cache/Kconfig
```kconfig
# SPDX-License-Identifier: GPL-2.0
config INTEGRITY_DIGEST_CACHE
	bool "Integrity Digest Cache"
	select MODULE_DECOMPRESS if MODULE_COMPRESS
	default n
	help
	  This option enables a cache of reference digests (e.g. of file
	  data or metadata) to be used by IMA and (later) by EVM, to verify
	  accessed files.

	  Digests can be extracted from supported data formats (e.g. a
	  TLV-based format). Support for more formats can be added through
	  third-party kernel modules.

config DIGEST_LIST_DEFAULT_PATH
	string
	default "/etc/digest_lists"
	help
	  Default path where the Integrity Digest Cache expects to find digest
	  lists.

	  It can be changed at run-time, by writing the new path to the
	  securityfs interface. Digest caches created with the old path are
	  not affected by the change.

config DIGEST_CACHE_HTABLE_DEPTH
	int
	default 30
	help
	  Desired average depth of the collision list in the digest cache
	  hash tables.

	  A smaller number will increase the amount of hash table slots, and
	  make the search faster. A bigger number will decrease the number of
	  hash table slots, but make the search slower.

config DIGEST_CACHE_TLV_PARSER
	tristate "TLV digest list parser"
	depends on INTEGRITY_DIGEST_CACHE
	select TLV_PARSER
	help
	  Add support for parsing TLV-formatted (Type Length Value)
	  digest list.
```
